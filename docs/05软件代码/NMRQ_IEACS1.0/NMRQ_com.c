/*****************************************************************
**文件名		:NMRQ_com.c
**文件描述      :PC与下位机之间的通信模块，使用UART0串口进行发送和
				 接收数据
**作者			:汤文兵
**创建日期		：2013-07-30
******************************************************************/

#include "..\Include\NMRQ_com.h"

/*****************************************************************
**函数名称	 	:COM_SendByteDown(INT8U data)
**参数说明	 	:INT8U data  发送的字节数据
**功能说明		:将data中的字节数据经由串口发送       
*****************************************************************/
void COM_SendByteDown(INT8U data)
{
	U0THR = data;	                               //将发送字节装入发送寄存器
	while((U0LSR & 0x40) ==0);	
}
/*****************************************************************
**函数名称	 	:COM_SendByteDown(INT8U const *str)
**参数说明	 	:INT8U const *str  发送的数据字串
**功能说明		:将data中的字节数据经由串口发送       
*****************************************************************/
void COM_SendDataDown(INT8U const *str)   
{  
	while(1)   
   	{  
		if( *str == '\0' ) break;   	//是否发送完毕，若发送完，则跳出
      	COM_SendByteDown(*str++);       // 否则继续发送数据    
   	}   
}
/*****************************************************************
**函数名称	 	:COM_RecvDataDown(INT8U data)
**参数说明	 	:INT8U data  发送的字节数据
**功能说明		:将str字串数据经由串口发送 
*****************************************************************/
INT8U COM_RecvDataDown(void)
{
	while((U0LSR & 0x01) == 0);		//当无数据的时候等待
	return U0RBR;
}




/*****************************************************************
**函数名称	 	:COM_PllPvbInit(void)
**参数说明	 	:无
**功能说明		:初始化系统时钟频率，锁相环设置      
*****************************************************************/
void COM_PllPvbInit(void)
{
#if (Fcco / Fcclk) == 2
    PLLCFG = ((Fcclk / Fosc) - 1) | (0 << 5);
#endif
#if (Fcco / Fcclk) == 4
    PLLCFG = ((Fcclk / Fosc) - 1) | (1 << 5);
#endif
#if (Fcco / Fcclk) == 8
    PLLCFG = ((Fcclk / Fosc) - 1) | (2 << 5);
#endif
#if (Fcco / Fcclk) == 16
    PLLCFG = ((Fcclk / Fosc) - 1) | (3 << 5);
#endif
    
#if (Fpclk / (Fcclk / 4)) == 1
    APBDIV = 0;
#endif
#if (Fpclk / (Fcclk / 4)) == 2
    APBDIV = 2;
#endif
#if (Fpclk / (Fcclk / 4)) == 4
    APBDIV = 1;
#endif

    PLLFEED = 0xaa;
    PLLFEED = 0x55;
    while((PLLSTAT & (1 << 10)) == 0);
    PLLCON = 3;
    PLLFEED = 0xaa;
    PLLFEED = 0x55;	
}

/*****************************************************************
**函数名称	 	:COM_PortInit(void)
**参数说明	 	:无
**功能说明		:初始化串口设置，设置波特率 
*****************************************************************/
void COM_PortInit()
{
	char Fdiv;
	PINSEL0 = 0x00000005;
	Fdiv = (Fpclk / 16) / UART_BPS;
	U0LCR = 0x83;
	U0DLM = Fdiv / 256;
	U0DLL = Fdiv % 256;
	U0LCR = 0x03;
	
	U1LCR = 0x83;
	U1DLM = Fdiv / 256;
	U1DLL = Fdiv % 256;
	U1LCR = 0x03;
}
/*****************************************************************
**函数名称	 	:COM_InitDown(void)
**参数说明	 	:无
**功能说明		:调用COM_PllPvbInit和COM_PortInit，初始化下位机端     
*****************************************************************/
void COM_InitDown()
{
	COM_PllPvbInit();	         //	锁相环初始化
	COM_PortInit();				 //	串口端口初始化
}
/*****************************************************************
**************************End of File*****************************
*****************************************************************/
